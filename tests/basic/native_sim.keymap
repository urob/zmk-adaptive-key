#include "../behavior_keymap.dtsi"

&kscan {
    events = <
        ZMK_MOCK_PRESS(0,0,10)
        ZMK_MOCK_RELEASE(0,0,200)
        ZMK_MOCK_PRESS(1,1,100)
        ZMK_MOCK_RELEASE(1,1,10)
    >;
};
