## Kconfig
```kconfig
menu "Adaptive Key Options"

config ZMK_ADAPTIVE_KEY_MAX_TRIGGER_CONDITIONS
    int "Maximum number of adaptive key triggers"
    default 32

config ZMK_ADAPTIVE_KEY_MAX_BINDINGS
    int "Maximum number of trigger bindings"
    default 4

config ZMK_ADAPTIVE_KEY_WAIT_MS
    int "Time to wait between key presses when binding multiple behaviors"
    default 5

config ZMK_ADAPTIVE_KEY_TAP_MS
    int "Time to hold key presses when binding multiple behaviors"
    default 5

#Adaptive key options
endmenu

DT_COMPAT_ZMK_BEHAVIOR_ADAPTIVE_KEY := zmk,behavior-adaptive-key

config ZMK_BEHAVIOR_ADAPTIVE_KEY
    bool
    default $(dt_compat_enabled,$(DT_COMPAT_ZMK_BEHAVIOR_ADAPTIVE_KEY))
```

## dts/bindings/behaviors/zmk,behavior-adaptive-key.yaml
```yaml
# Copyright (c) 2024 The ZMK Contributors
# SPDX-License-Identifier: MIT

description: Adaptive key behavior

compatible: "zmk,behavior-adaptive-key"

include: zero_param.yaml

properties:
  bindings:
    type: phandle-array
    description: |
      Default binding if no trigger condition is met.
    required: true
  dead-keys:
    type: array
    description: |
      List of key codes that are converted into dead keys.
    default: []
  delete-keycode:
    type: int
    description: |
      Keycode to press when delete-prior is set.

child-binding:
  description: "An adaptive key condition"

  properties:
    bindings:
      type: phandle-array
      required: true
    trigger-keys:
      type: array
      required: true
    max-prior-idle-ms:
      type: int
      default: -1
    min-prior-idle-ms:
      type: int
      default: -1
    delete-prior:
      type: boolean
    strict-modifiers:
      type: boolean
```

## tests/west.yml
```yaml
manifest:
  remotes:
    - name: zmkfirmware
      url-base: https://github.com/zmkfirmware
    - name: urob
      url-base: https://github.com/urob
  projects:
    - name: zmk
      remote: zmkfirmware
      revision: v0.2.1
      import: app/west.yml
    # Apply patch to fix child nodes issue
    - name: zephyr
      remote: urob
      revision: v3.5.0+zmk-fixes
      clone-depth: 1
      import:
        name-allowlist: [lvgl]
  self:
    path: tests
```
